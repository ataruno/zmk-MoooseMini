## config/boards/shields/MoooseMini/Kconfig.shield
```kconfig
# Copyright (c) 2022 The ZMK Contributors
# SPDX-License-Identifier: MIT

config SHIELD_MoooseMini
    def_bool $(shields_list_contains,MoooseMini)
```

## config/west.yml
```yaml
manifest:
  remotes:
    - name: zmkfirmware
      url-base: https://github.com/petejohanson
    - name: ataruno-git
      url-base: https://github.com/ataruno
  projects:
    - name: zmk
      remote: zmkfirmware
      revision: feat/pointers-move-scroll
      import: app/west.yml
    - name: zmk-pmw3610-driver
      remote: ataruno-git
      revision: main
  self:
    path: config
```
